## m720q/defconfig
```kconfig
CONFIG_TIMESTAMPS_ON_CONSOLE=y
CONFIG_BOOTSPLASH_IMAGE=y
CONFIG_SBOM=y
CONFIG_SBOM_COMPILER=y
CONFIG_SBOM_PAYLOAD=y
CONFIG_SBOM_MICROCODE=y
CONFIG_VENDOR_LENOVO=y
CONFIG_NO_POST=y
CONFIG_LINEAR_FRAMEBUFFER_MAX_HEIGHT=768
CONFIG_LINEAR_FRAMEBUFFER_MAX_WIDTH=1024
CONFIG_BOARD_LENOVO_M720Q=y
CONFIG_EDK2_BOOTSPLASH_FILE="bootsplash.jpg"
CONFIG_BOOTSPLASH=y
CONFIG_DRIVERS_PS2_KEYBOARD=y
CONFIG_PAYLOAD_EDK2=y
CONFIG_EDK2_CBMEM_LOGGING=y
# CONFIG_EDK2_SECURE_BOOT_SUPPORT is not set
CONFIG_COREINFO_SECONDARY_PAYLOAD=y
CONFIG_MEMTEST_SECONDARY_PAYLOAD=y
CONFIG_NVRAMCUI_SECONDARY_PAYLOAD=y
CONFIG_TINT_SECONDARY_PAYLOAD=y
CONFIG_MEMTEST86PLUS_V5=y
```

## m920q/defconfig
```kconfig
CONFIG_TIMESTAMPS_ON_CONSOLE=y
CONFIG_BOOTSPLASH_IMAGE=y
CONFIG_SBOM=y
CONFIG_SBOM_COMPILER=y
CONFIG_SBOM_PAYLOAD=y
CONFIG_SBOM_MICROCODE=y
CONFIG_VENDOR_LENOVO=y
CONFIG_NO_POST=y
CONFIG_LINEAR_FRAMEBUFFER_MAX_HEIGHT=768
CONFIG_LINEAR_FRAMEBUFFER_MAX_WIDTH=1024
CONFIG_PCIEXP_L1_SUB_STATE=y
CONFIG_BOARD_LENOVO_M920Q=y
CONFIG_EDK2_BOOTSPLASH_FILE="bootsplash.jpg"
CONFIG_HIDE_MEI_ON_ERROR=y
CONFIG_H8_SUPPORT_BT_ON_WIFI=y
CONFIG_BOOTSPLASH=y
CONFIG_USBDEBUG=y
CONFIG_DRIVERS_PS2_KEYBOARD=y
CONFIG_PAYLOAD_EDK2=y
CONFIG_EDK2_CBMEM_LOGGING=y
CONFIG_COREINFO_SECONDARY_PAYLOAD=y
CONFIG_MEMTEST_SECONDARY_PAYLOAD=y
CONFIG_NVRAMCUI_SECONDARY_PAYLOAD=y
CONFIG_TINT_SECONDARY_PAYLOAD=y
CONFIG_MEMTEST86PLUS_V5=y
```
