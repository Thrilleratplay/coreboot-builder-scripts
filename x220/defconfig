## x220/defconfig
```kconfig
CONFIG_TIMESTAMPS_ON_CONSOLE=y
CONFIG_BOOTSPLASH_IMAGE=y
CONFIG_SBOM=y
CONFIG_SBOM_COMPILER=y
CONFIG_SBOM_PAYLOAD=y
CONFIG_SBOM_MICROCODE=y
CONFIG_VENDOR_LENOVO=y
CONFIG_NO_POST=y
CONFIG_CBFS_SIZE=0x300000
CONFIG_LINEAR_FRAMEBUFFER_MAX_HEIGHT=768
CONFIG_LINEAR_FRAMEBUFFER_MAX_WIDTH=1024
CONFIG_INTEL_GMA_VBT_FILE="src/mainboard/$(MAINBOARDDIR)/variants/x220/data.vbt"
CONFIG_BOARD_LENOVO_X220=y
CONFIG_EDK2_BOOTSPLASH_FILE="bootsplash.jpg"
CONFIG_HIDE_MEI_ON_ERROR=y
CONFIG_H8_SUPPORT_BT_ON_WIFI=y
CONFIG_BOOTSPLASH=y
CONFIG_PCIEXP_HOTPLUG_IO=0x2000
CONFIG_RESOURCE_ALLOCATION_TOP_DOWN=y
CONFIG_USBDEBUG=y
CONFIG_DRIVERS_PS2_KEYBOARD=y
CONFIG_SECURITY_CLEAR_DRAM_ON_REGULAR_BOOT=y
CONFIG_DEFAULT_CONSOLE_LOGLEVEL_6=y
CONFIG_PAYLOAD_EDK2=y
CONFIG_EDK2_CBMEM_LOGGING=y
CONFIG_EDK2_CUSTOM_BUILD_PARAMS=""
CONFIG_COREINFO_SECONDARY_PAYLOAD=y
CONFIG_MEMTEST_SECONDARY_PAYLOAD=y
CONFIG_NVRAMCUI_SECONDARY_PAYLOAD=y
CONFIG_TINT_SECONDARY_PAYLOAD=y
CONFIG_MEMTEST86PLUS_V5=y
```

## x230t/defconfig
```kconfig
CONFIG_TIMESTAMPS_ON_CONSOLE=y
CONFIG_BOOTSPLASH_IMAGE=y
CONFIG_SBOM=y
CONFIG_SBOM_COMPILER=y
CONFIG_SBOM_PAYLOAD=y
CONFIG_SBOM_MICROCODE=y
CONFIG_VENDOR_LENOVO=y
CONFIG_NO_POST=y
CONFIG_CBFS_SIZE=0x300000
CONFIG_LINEAR_FRAMEBUFFER_MAX_HEIGHT=768
CONFIG_LINEAR_FRAMEBUFFER_MAX_WIDTH=1024
CONFIG_PCIEXP_L1_SUB_STATE=y
CONFIG_PCIEXP_CLK_PM=y
CONFIG_INTEL_GMA_VBT_FILE="src/mainboard/$(MAINBOARDDIR)/variants/x230/data.vbt"
CONFIG_BOARD_LENOVO_X230T=y
CONFIG_EDK2_BOOTSPLASH_FILE="bootsplash.jpg"
CONFIG_HIDE_MEI_ON_ERROR=y
CONFIG_H8_SUPPORT_BT_ON_WIFI=y
CONFIG_BOOTSPLASH=y
CONFIG_USBDEBUG=y
CONFIG_DRIVERS_PS2_KEYBOARD=y
CONFIG_SECURITY_CLEAR_DRAM_ON_REGULAR_BOOT=y
CONFIG_PAYLOAD_EDK2=y
CONFIG_EDK2_CBMEM_LOGGING=y
# CONFIG_EDK2_SECURE_BOOT_SUPPORT is not set
CONFIG_COREINFO_SECONDARY_PAYLOAD=y
CONFIG_MEMTEST_SECONDARY_PAYLOAD=y
CONFIG_NVRAMCUI_SECONDARY_PAYLOAD=y
CONFIG_TINT_SECONDARY_PAYLOAD=y
CONFIG_MEMTEST86PLUS_V5=y
```
